## meta-i2c-sh110x/conf/layer.conf
```bitbake
BBPATH .= ":${LAYERDIR}"
BBFILES += "${LAYERDIR}/recipes-*/*/*.bb ${LAYERDIR}/recipes-*/*/*.bbappend ${LAYERDIR}/recipes-*/*/*/*.bb"
BBFILE_COLLECTIONS += "meta-i2c-sh110x"
BBFILE_PATTERN_meta-i2c-sh110x = "^${LAYERDIR}/"
BBFILE_PRIORITY_meta-i2c-sh110x = "5"
LAYERSERIES_COMPAT_meta-i2c-sh110x = "gatesgarth"
```
